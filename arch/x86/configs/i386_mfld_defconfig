## arch/x86/configs/i386_mfld_defconfig
```kconfig
CONFIG_EXPERIMENTAL=y
CONFIG_SYSVIPC=y
CONFIG_POSIX_MQUEUE=y
CONFIG_BSD_PROCESS_ACCT=y
CONFIG_BSD_PROCESS_ACCT_V3=y
CONFIG_FHANDLE=y
CONFIG_AUDIT=y
CONFIG_AUDITSYSCALL=y
CONFIG_LOG_BUF_SHIFT=18
CONFIG_CGROUP_FREEZER=y
CONFIG_CGROUP_DEVICE=y
CONFIG_CPUSETS=y
CONFIG_CGROUP_CPUACCT=y
CONFIG_RESOURCE_COUNTERS=y
CONFIG_CGROUP_MEM_RES_CTLR=y
CONFIG_CGROUP_MEM_RES_CTLR_SWAP=y
CONFIG_CGROUP_PERF=y
CONFIG_BLK_CGROUP=y
CONFIG_NAMESPACES=y
CONFIG_SCHED_AUTOGROUP=y
CONFIG_BLK_DEV_INITRD=y
CONFIG_RD_LZO=y
CONFIG_CC_OPTIMIZE_FOR_SIZE=y
CONFIG_PANIC_TIMEOUT=1
CONFIG_EMBEDDED=y
# CONFIG_COMPAT_BRK is not set
CONFIG_PROFILING=y
CONFIG_MODULES=y
CONFIG_MODULE_UNLOAD=y
CONFIG_MODVERSIONS=y
# CONFIG_BLK_DEV_BSG is not set
CONFIG_BLK_DEV_THROTTLING=y
CONFIG_CFQ_GROUP_IOSCHED=y
CONFIG_NO_HZ=y
CONFIG_HIGH_RES_TIMERS=y
CONFIG_SMP=y
CONFIG_X86_INTEL_MID=y
CONFIG_X86_MDFLD=y
CONFIG_MATOM=y
# CONFIG_DMI is not set
CONFIG_SCHED_SMT=y
CONFIG_PREEMPT=y
# CONFIG_VM86 is not set
CONFIG_X86_REBOOTFIXUPS=y
CONFIG_MICROCODE=y
CONFIG_X86_MSR=y
CONFIG_X86_CPUID=y
CONFIG_HIGHMEM64G=y
# CONFIG_MTRR_SANITIZER is not set
# CONFIG_SECCOMP is not set
CONFIG_CC_STACKPROTECTOR=y
CONFIG_HZ_1000=y
CONFIG_KEXEC=y
# CONFIG_RELOCATABLE is not set
CONFIG_PHYSICAL_ALIGN=0x100000
# CONFIG_COMPAT_VDSO is not set
CONFIG_PM_RUNTIME=y
CONFIG_PM_DEBUG=y
CONFIG_PM_ADVANCED_DEBUG=y
# CONFIG_ACPI is not set
CONFIG_SFI=y
CONFIG_CPU_FREQ=y
CONFIG_CPU_FREQ_DEFAULT_GOV_ONDEMAND=y
CONFIG_CPU_FREQ_GOV_POWERSAVE=y
CONFIG_CPU_FREQ_GOV_USERSPACE=y
CONFIG_X86_SFI_CPUFREQ=y
CONFIG_CPU_IDLE=y
CONFIG_INTEL_IDLE=y
CONFIG_PCIEPORTBUS=y
# CONFIG_PCIEAER is not set
# CONFIG_PCIEASPM is not set
CONFIG_PCI_MSI=y
# CONFIG_HT_IRQ is not set
# CONFIG_CORE_DUMP_DEFAULT_ELF_HEADERS is not set
CONFIG_BINFMT_MISC=y
CONFIG_NET=y
CONFIG_PACKET=y
CONFIG_UNIX=y
CONFIG_XFRM_USER=y
CONFIG_INET=y
CONFIG_IP_MULTICAST=y
CONFIG_IP_ADVANCED_ROUTER=y
CONFIG_IP_PNP=y
CONFIG_NET_IPIP=y
CONFIG_NET_IPGRE_DEMUX=y
CONFIG_NET_IPGRE=y
CONFIG_NET_IPGRE_BROADCAST=y
CONFIG_IPV6=y
CONFIG_IPV6_PRIVACY=y
# CONFIG_ANDROID_PARANOID_NETWORK is not set
CONFIG_NETFILTER=y
CONFIG_NF_CONNTRACK=y
CONFIG_NF_CONNTRACK_PPTP=y
CONFIG_NETFILTER_TPROXY=y
CONFIG_NETFILTER_XT_MATCH_QUOTA2=y
CONFIG_NETFILTER_XT_MATCH_QUOTA2_LOG=y
CONFIG_NF_CONNTRACK_IPV4=y
CONFIG_IP_NF_IPTABLES=y
CONFIG_NF_NAT=y
CONFIG_IP_NF_MANGLE=y
CONFIG_IP_NF_RAW=y
CONFIG_NF_CONNTRACK_IPV6=y
CONFIG_IP6_NF_IPTABLES=y
CONFIG_IP6_NF_FILTER=y
CONFIG_IP6_NF_MANGLE=y
CONFIG_IP6_NF_RAW=y
CONFIG_L2TP=y
CONFIG_L2TP_V3=y
CONFIG_L2TP_IP=y
CONFIG_L2TP_ETH=y
CONFIG_PHONET=y
CONFIG_BT=y
CONFIG_BT_L2CAP=y
CONFIG_BT_SCO=y
CONFIG_BT_RFCOMM=y
CONFIG_BT_RFCOMM_TTY=y
CONFIG_BT_BNEP=y
CONFIG_BT_BNEP_MC_FILTER=y
CONFIG_BT_BNEP_PROTO_FILTER=y
CONFIG_BT_HIDP=y
CONFIG_BT_HCIUART=y
CONFIG_BT_WILINK=m
CONFIG_CFG80211=y
CONFIG_MAC80211=y
CONFIG_RFKILL=y
CONFIG_UEVENT_HELPER_PATH="/sbin/hotplug"
CONFIG_DEVTMPFS=y
CONFIG_DEVTMPFS_MOUNT=y
CONFIG_DEBUG_DEVRES=y
CONFIG_BLK_DEV_LOOP=y
CONFIG_BLK_DEV_RAM=y
CONFIG_BLK_DEV_RAM_SIZE=16384
CONFIG_MISC_DEVICES=y
CONFIG_INTEL_MID_PTI=y
CONFIG_SENSORS_APDS990X=y
CONFIG_UID_STAT=y
CONFIG_SOC_DUMP=m
CONFIG_MSIC_DUMP=m
CONFIG_SCSI=y
CONFIG_BLK_DEV_SD=y
CONFIG_BLK_DEV_SR=y
CONFIG_BLK_DEV_SR_VENDOR=y
CONFIG_CHR_DEV_SG=y
CONFIG_SCSI_CONSTANTS=y
CONFIG_SCSI_SPI_ATTRS=y
# CONFIG_SCSI_LOWLEVEL is not set
CONFIG_MD=y
CONFIG_BLK_DEV_DM=y
CONFIG_DM_CRYPT=y
CONFIG_NETDEVICES=y
CONFIG_TUN=y
CONFIG_NET_ETHERNET=y
CONFIG_WL12XX_MENU=m
CONFIG_WL12XX=m
CONFIG_WL12XX_SDIO=m
CONFIG_USB_USBNET=y
CONFIG_USB_CDC_PHONET=m
CONFIG_PPP=y
CONFIG_PPP_MULTILINK=y
CONFIG_PPP_FILTER=y
CONFIG_PPP_ASYNC=y
CONFIG_PPP_SYNC_TTY=y
CONFIG_PPP_DEFLATE=y
CONFIG_PPP_BSDCOMP=y
CONFIG_PPP_MPPE=y
CONFIG_PPPOE=y
CONFIG_PPTP=y
CONFIG_PPPOL2TP=y
CONFIG_PPPOLAC=y
CONFIG_PPPOPNS=y
CONFIG_INPUT_FF_MEMLESS=y
# CONFIG_INPUT_MOUSEDEV_PSAUX is not set
CONFIG_INPUT_EVDEV=y
CONFIG_KEYBOARD_GPIO=y
CONFIG_KEYBOARD_INTEL_MID=y
CONFIG_INPUT_TOUCHSCREEN=y
CONFIG_TOUCHSCREEN_ATMEL_MXT=m
CONFIG_INPUT_MISC=y
CONFIG_INPUT_MPU3050=y
CONFIG_INPUT_UINPUT=y
CONFIG_INPUT_LIS3DH_ACC=y
CONFIG_INPUT_LTR301ALS=y
CONFIG_VT_HW_CONSOLE_BINDING=y
# CONFIG_LEGACY_PTYS is not set
CONFIG_SERIAL_NONSTANDARD=y
CONFIG_N_GSM=y
CONFIG_TRACE_ROUTER=y
CONFIG_TRACE_SINK=y
CONFIG_SERIAL_MRST_MAX3110=y
CONFIG_SERIAL_MFD_HSU=y
CONFIG_SERIAL_MFD_HSU_CONSOLE=y
CONFIG_HW_RANDOM=y
CONFIG_NVRAM=y
CONFIG_I2C_CHARDEV=y
CONFIG_I2C_DESIGNWARE_PCI=y
CONFIG_I2C_GPIO=y
CONFIG_SPI_BITBANG=y
CONFIG_SPI_INTEL_MID_SSP=y
CONFIG_SPI_DESIGNWARE=y
CONFIG_SPI_DW_PCI=y
CONFIG_HSI=y
CONFIG_HSI_INTEL_MID=y
CONFIG_HSI_CHAR=y
CONFIG_HSI_FFL_TTY=y
CONFIG_HSI_FFL_TTY_CHANNEL=1
CONFIG_HSI_FFL_TTY_STATS=y
CONFIG_GPIOLIB=y
CONFIG_GPIO_SYSFS=y
CONFIG_GPIO_LANGWELL=y
CONFIG_POWER_SUPPLY=y
CONFIG_BATTERY_MAX17042=y
CONFIG_CHARGER_SMB347=y
CONFIG_SENSORS_LTR502ALS=y
CONFIG_SENSORS_MS5607=y
CONFIG_MSIC_GPADC=y
CONFIG_SENSORS_HMC5883=y
CONFIG_THERMAL=y
CONFIG_WATCHDOG=y
CONFIG_INTEL_SCU_WATCHDOG=y
CONFIG_REGULATOR=y
CONFIG_REGULATOR_FIXED_VOLTAGE=y
CONFIG_MEDIA_SUPPORT=y
CONFIG_MEDIA_CONTROLLER=y
CONFIG_VIDEO_DEV=y
CONFIG_VIDEO_V4L2_SUBDEV_API=y
# CONFIG_RC_MAP is not set
# CONFIG_IR_NEC_DECODER is not set
# CONFIG_IR_RC5_DECODER is not set
# CONFIG_IR_RC6_DECODER is not set
# CONFIG_IR_JVC_DECODER is not set
# CONFIG_IR_SONY_DECODER is not set
# CONFIG_IR_RC5_SZ_DECODER is not set
# CONFIG_MEDIA_TUNER_CUSTOMISE is not set
# CONFIG_V4L_USB_DRIVERS is not set
CONFIG_VIDEO_ATOMISP=m
CONFIG_RADIO_WL128X=m
CONFIG_AGP=y
CONFIG_AGP_INTEL=y
CONFIG_DRM=y
CONFIG_VIDEO_OUTPUT_CONTROL=y
CONFIG_BACKLIGHT_LCD_SUPPORT=y
CONFIG_LCD_CLASS_DEVICE=y
CONFIG_BACKLIGHT_CLASS_DEVICE=y
CONFIG_VGACON_SOFT_SCROLLBACK=y
CONFIG_FRAMEBUFFER_CONSOLE=y
CONFIG_SOUND=y
CONFIG_SND=y
CONFIG_SND_SEQUENCER=y
# CONFIG_SND_SUPPORT_OLD_API is not set
# CONFIG_SND_VERBOSE_PROCFS is not set
CONFIG_SND_INTEL_MID_I2S=m
CONFIG_SND_INTEL_ALSA_SSP=m
# CONFIG_SND_USB is not set
CONFIG_SND_SOC=y
CONFIG_SND_MFLD_MACHINE=m
CONFIG_HIDRAW=y
CONFIG_HID_PID=y
CONFIG_USB=y
# CONFIG_USB_DEVICE_CLASS is not set
CONFIG_USB_SUSPEND=y
# CONFIG_USB_OTG_WHITELIST is not set
CONFIG_USB_EHCI_HCD=y
CONFIG_USB_EHCI_ROOT_HUB_TT=y
CONFIG_USB_STORAGE=y
CONFIG_USB_GADGET=y
CONFIG_USB_GADGET_LANGWELL=y
CONFIG_USB_ZERO=m
CONFIG_USB_ZERO_HNPTEST=y
CONFIG_USB_ETH=m
CONFIG_USB_ETH_EEM=y
CONFIG_USB_MASS_STORAGE=m
CONFIG_USB_G_SERIAL=m
CONFIG_USB_PENWELL_OTG=y
CONFIG_MMC=y
CONFIG_MMC_UNSAFE_RESUME=y
CONFIG_MMC_EMBEDDED_SDIO=y
CONFIG_MMC_SDHCI=y
CONFIG_MMC_SDHCI_PCI=y
CONFIG_NEW_LEDS=y
CONFIG_LEDS_CLASS=y
CONFIG_NFC_DEVICES=y
CONFIG_PN544_NFC=m
CONFIG_SWITCH=y
CONFIG_SWITCH_GPIO=y
CONFIG_RTC_CLASS=y
# CONFIG_RTC_DRV_CMOS is not set
CONFIG_DMADEVICES=y
CONFIG_INTEL_MID_DMAC=y
CONFIG_STAGING=y
CONFIG_SND_INTEL_SST=y
CONFIG_DRM_INTEL_MID=y
CONFIG_PVR_DEBUG=y
CONFIG_DRM_MDFLD=y
# CONFIG_MDFLD_DSI_DSR is not set
CONFIG_PVR_TRACE_CMD=y
CONFIG_PVR_TRACE_FW_DUMP_TO_CONSOLE=y
CONFIG_INTEL_MID_POWER_BUTTON=y
CONFIG_INTEL_MID_OSIP=y
CONFIG_INTEL_MFLD_THERMAL=y
CONFIG_EXT4_FS=y
CONFIG_BTRFS_FS=y
CONFIG_FANOTIFY=y
CONFIG_QUOTA=y
# CONFIG_PRINT_QUOTA_WARNING is not set
CONFIG_QFMT_V2=y
CONFIG_AUTOFS4_FS=y
CONFIG_ISO9660_FS=y
CONFIG_JOLIET=y
CONFIG_ZISOFS=y
CONFIG_MSDOS_FS=y
CONFIG_VFAT_FS=y
CONFIG_PROC_KCORE=y
CONFIG_TMPFS=y
CONFIG_TMPFS_POSIX_ACL=y
CONFIG_HUGETLBFS=y
# CONFIG_MISC_FILESYSTEMS is not set
CONFIG_NFS_FS=y
CONFIG_NFS_V3=y
CONFIG_NFS_V3_ACL=y
CONFIG_ROOT_NFS=y
CONFIG_PARTITION_ADVANCED=y
CONFIG_OSF_PARTITION=y
CONFIG_AMIGA_PARTITION=y
CONFIG_MAC_PARTITION=y
CONFIG_BSD_DISKLABEL=y
CONFIG_MINIX_SUBPARTITION=y
CONFIG_SOLARIS_X86_PARTITION=y
CONFIG_UNIXWARE_DISKLABEL=y
CONFIG_SGI_PARTITION=y
CONFIG_SUN_PARTITION=y
CONFIG_KARMA_PARTITION=y
CONFIG_EFI_PARTITION=y
CONFIG_NLS_DEFAULT="utf8"
CONFIG_NLS_CODEPAGE_437=y
CONFIG_NLS_ASCII=y
CONFIG_NLS_ISO8859_1=y
CONFIG_NLS_UTF8=y
CONFIG_PRINTK_TIME=y
CONFIG_FRAME_WARN=2048
CONFIG_MAGIC_SYSRQ=y
# CONFIG_UNUSED_SYMBOLS is not set
CONFIG_DEBUG_KERNEL=y
CONFIG_DEBUG_SHIRQ=y
CONFIG_DETECT_HUNG_TASK=y
CONFIG_SCHEDSTATS=y
CONFIG_TIMER_STATS=y
CONFIG_SLUB_DEBUG_ON=y
CONFIG_PROVE_LOCKING=y
CONFIG_PROVE_RCU=y
CONFIG_DEBUG_LOCKDEP=y
CONFIG_DEBUG_SPINLOCK_SLEEP=y
CONFIG_DEBUG_STACK_USAGE=y
CONFIG_DEBUG_INFO=y
CONFIG_DEBUG_LIST=y
CONFIG_SYSCTL_SYSCALL_CHECK=y
CONFIG_FTRACE_SYSCALLS=y
CONFIG_BLK_DEV_IO_TRACE=y
CONFIG_PROVIDE_OHCI1394_DMA_INIT=y
CONFIG_EARLY_PRINTK_INTEL_MID=y
CONFIG_DEBUG_STACKOVERFLOW=y
# CONFIG_DEBUG_RODATA_TEST is not set
CONFIG_DEBUG_NX_TEST=m
CONFIG_DEBUG_BOOT_PARAMS=y
CONFIG_OPTIMIZE_INLINING=y
CONFIG_KEYS=y
CONFIG_KEYS_DEBUG_PROC_KEYS=y
CONFIG_SECURITY=y
CONFIG_SECURITY_NETWORK=y
CONFIG_CRYPTO_SHA256=y
CONFIG_CRYPTO_SHA512=y
CONFIG_CRYPTO_AES_NI_INTEL=y
# CONFIG_VIRTUALIZATION is not set
CONFIG_CRC_T10DIF=y
```

## drivers/misc/soc_dump/Kconfig
```kconfig
menu "SOC register dump support"

config SOC_DUMP
       tristate "SOC register dump support"
	depends on X86_INTEL_MID

config PMIC_POWER_DUMP
       tristate "Dump PMIC power registers"
       depends on SOC_DUMP

config PMIC_GPIO_DUMP
       tristate "Dump PMIC GPIO registers"
       depends on SOC_DUMP

config PMIC_LED_LCD_DUMP
       tristate "Dump PMIC LED/LCD registers"
       depends on SOC_DUMP

config PMIC_RTC_DUMP
       tristate "Dump PMIC RTC registers"
       depends on SOC_DUMP

config PMIC_BATT_DUMP
       tristate "Dump PMIC battery registers"
       depends on SOC_DUMP

config MSIC_DUMP
       tristate "Dump MSIC registers"
       depends on SOC_DUMP
       depends on MFD_INTEL_MSIC

endmenu
```

## drivers/staging/ice4100/Kconfig
```kconfig
#
# Intel CE device configuration
#
# This driver provides support for the
# Intel CE media processors
#
menu "Intel CE Media Processor"

config X86_INTEL_CE
	bool "Intel CE Media Processor Drivers"
	default N
	help
	  Enable support for the Intel CE Media Processor functions

choice
	prompt "Build Intel CE kernel services as "
	depends on X86_INTEL_CE
	default CE_RELEASE

config CE_RELEASE
	bool "Release"
	depends on X86_INTEL_CE
	help
	  Build Intel CE kernel services as release

config CE_DEBUG
	bool "Debug"
	depends on X86_INTEL_CE
	help
	 Build Intel CE kernel services as debug

endchoice

if X86_INTEL_CE

config CE_SGX_GFX
	tristate "SGX Power VR graphics core driver"
	help
	  Driver for 2D and 3D accelerated graphics core

endif

endmenu
```

## drivers/staging/mfld-sensors/Kconfig
```kconfig
menuconfig MFLD_SENSORS
	bool "Intel Medfield Sensor Device Drivers"
	default y
	---help---
	  Say Y here to get to see options for device drivers for various
	  sensor devices on Medfiled.
	  This option alone does not add any kernel code.

	  If you say N, all options in this submenu will be skipped and disabled.

if MFLD_SENSORS
config SENSORS_AK8974COMPASS
	tristate "Ak8974/AMI304 Compass Module"
	depends on I2C
	help
	  To get Compass Sensor output from AK8974/AMI304 sensor.

config SENSORS_APDS9802PSPROXIMITY
        tristate "Medfield Avago APDS9802 Proximity Sensor Module"
        depends on I2C
        help
          To get Proximity Sensor output from APDS9802
          Proximity sensor.
endif #MFLD_SENSORS
```

## drivers/staging/mrst/Kconfig
```kconfig
#
# Drm device configuration
#
# This driver provides support for the
# Direct Rendering Infrastructure (DRI) in XFree86 4.1.0 and higher.
#

config DRM_INTEL_MID
	tristate "Intel Moorestown/Medfield (load along with IMG driver)"
	depends on DRM && PCI
	select FB_CFB_COPYAREA
        select FB_CFB_FILLRECT
        select FB_CFB_IMAGEBLIT
        select DRM_KMS_HELPER
        select DRM_TTM
	help
	  xxxxxxxxxxxxxxxxxxxxxxxxxx

choice
	prompt "PVR ABI version"
	depends on DRM_INTEL_MID
	default PVR_ABI_RELEASE

config PVR_ABI_RELEASE
	bool "Release ABI"
	depends on DRM_INTEL_MID
	help
	  Select release mode for the IOCTL and firmware ABI. Note
	  that this will work only with the PVR user space libraries
	  built with the release mode ABI option too.


config PVR_ABI_DEBUG
	bool "Debug ABI"
	depends on DRM_INTEL_MID
	help
	  Select debug mode for the IOCTL and firmware ABI. This will
	  enable extra debugging options with the help of the user space
	  libraries, like PDUMP (PDUMP needs to be enabled separately).

	  Note that this will work only with the PVR user space libraries
	  built with the debug mode ABI option too.

endchoice

config PVR_DEBUG
	bool "PVR debug messages/asserts"
	depends on DRM_INTEL_MID
	help
	  Enable debug messages and asserts.

config DRM_MDFLD
	tristate "Intel Medfield"
        depends on DRM_INTEL_MID && PCI
        select FB_CFB_COPYAREA
        select FB_CFB_FILLRECT
        select FB_CFB_IMAGEBLIT
        select DRM_KMS_HELPER
        help
          Choose this option if you have a Medfield platform.
          If M is selected the module will be called mid_gfx.

config MDFLD_DSI_DSR
	bool "Support DSI Fullscreen Display Self Refreshment "
	depends on DRM_MDFLD && !MDFLD_DSI_DPU
	default y
	help
	  Choose this option if you have a Type1 MIPI panel.

config MDFLD_DSI_DPU
	bool "Support DSI Display Partial Update"
	depends on DRM_MDFLD
	default n
	help
	  xxxxxx

config MDFD_DUAL_MIPI
        bool "SUPPORT_DUAL_MIPI_DISPLAYS"
        depends on DRM_MDFLD
        default n
        help
          xxxxxx

config MDFD_HDMI
        bool "SUPPORT_HDMI_DISPLAY"
        depends on DRM_MDFLD
        default n
        help
          xxxxxx

choice
	  prompt "HDMI board support"
	  depends on MDFD_HDMI
	  default MDFD_HDMI_REDRIDGE

config MDFD_HDMI_GREENRIDGE
	  bool "Greenridge HDMI support"
	  depends on MDFD_HDMI
	  help
	    HDMI support for Greenridge.

config MDFD_HDMI_REDRIDGE
	  bool "Red Ridge HDMI support"
	  depends on MDFD_HDMI
	  help
	    HDMI support for Red Ridge.

config MDFD_HDMI_PR2
	  bool "PR2 HDMI support"
	  depends on MDFD_HDMI
	  help
	    HDMI support for PR2.

endchoice

config MDFD_GL3
	bool "Enable GL3 Cache for GUNIT"
	depends on DRM_MDFLD
	default n
	help
	  xxxxxx

config PVR_TRACE_CMD
	depends on DRM_INTEL_MID
	bool "Enable GPU command tracing"
	default n
	help
	  This will enable a lightweight tracer of commands submitted
	  to the GPU.

	  Besides the command type the trace output will provide the
	  timestamp, id and name of the submitting process and a
	  a snapshots of the synchronization counters related to the
	  given command.

	  The trace can help for example in debugging dead-lock
	  situations caused by circular lock dependencies.

config PVR_TRACE_CMD_BUF_SHIFT
	int "Command tracing buf size"
	range 1 10
	default 3
	depends on PVR_TRACE_CMD
	help
	  Select the number of pages (as a power of 2) set aside for
	  the command trace buffer.
	  Examples:
	  1  -> 4kB
	  3  -> 32kB
	  10 -> 4MB

config PVR_TRACE_FW_DUMP_TO_CONSOLE
	bool "Dump firmware trace to console in case of SGX HW recovery"
	default n
	help
	  Answer y, if you want the firmware trace to be dumped to the
	  console automatically, in case of an SGX HW recovery. Note that
	  for this, you need a PVR user space library (and the firmware
	  within that) built with tracing enabled. The same trace is also
	  available through the firmware_trace PVR debugfs entry.
```
